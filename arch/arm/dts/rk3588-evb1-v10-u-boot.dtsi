// SPDX-License-Identifier: (GPL-2.0+ OR MIT)
/*
 * Copyright (c) 2023 Rockchip Electronics Co., Ltd.
 */

#include "rk3588-u-boot.dtsi"

/ {
	chosen {
		u-boot,spl-boot-order = "same-as-spl", &sdhci;
	};
};

/*
&sdhci {
	cap-mmc-highspeed;
	mmc-hs200-1_8v;
	/delete-property/ mmc-hs400-1.8v;
};
*/
