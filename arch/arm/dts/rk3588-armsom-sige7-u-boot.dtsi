// SPDX-License-Identifier: (GPL-2.0+ OR MIT)
/*
 * Copyright (c) 2024 ArmSoM Technology Co., Ltd.
 */

#include "rk3588-u-boot.dtsi"

#if defined(CONFIG_SYSINFO_SMBIOS)
#include "smbios_generic.dtsi"
#endif
